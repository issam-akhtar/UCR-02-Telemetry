
#include <WiFi.h>

// Wi-Fi credentials
const char* ssid = "Akmals"; //Change to required network
const char* password = ""; //Change to required password

// Server details (computer IP and port)
const char* serverIP = "10.0.0.200"; // Change this to the receiving computer's IP
const uint16_t serverPort = 12345;

WiFiClient client;

// Simulated CAN packet data
struct CanPacket {
  float timestamp;
  const char* data;
};

// Sample CAN data with initial 50 packets and timestamps
CanPacket canData[] = {
  {0.34959, "{\"Time\":0.34959, \"Channel\":1, \"ID\":513, \"Flags\":2, \"DLC\":3, \"Data\":[\"90\", \"00\", \"00\"], \"Counter\":1, \"AbsTime\":\"2024-10-16 0:16\"}"},
  {0.35339, "{\"Time\":0.35339, \"Channel\":2, \"ID\":1552, \"Flags\":\"196610\", \"DLC\":11, \"Data\":[\"00\", \"03\", \"00\", \"c8\", \"43\", \"04\", \"41\", \"f7\", \"17\", \"1b\", \"70\", \"06\"], \"Counter\":2, \"AbsTime\":\"2024-10-16 0:16\"}"},
  {0.35352, "{\"Time\":0.35352, \"Channel\":2, \"ID\":1553, \"Flags\":\"196610\", \"DLC\":11, \"Data\":[\"c9\", \"f9\", \"09\", \"2f\", \"d5\", \"03\", \"62\", \"ca\", \"08\", \"e0\", \"11\", \"08\"], \"Counter\":3, \"AbsTime\":\"2024-10-16 0:16\"}"},
  {0.35435, "{\"Time\":0.35435, \"Channel\":2, \"ID\":259, \"Flags\":\"196610\", \"DLC\":10, \"Data\":[\"dc\", \"08\", \"c0\", \"08\", \"57\", \"0b\", \"a6\", \"09\", \"07\", \"0d\", \"a0\", \"0d\", \"b7\", \"01\", \"ff\", \"0f\"], \"Counter\":4, \"AbsTime\":\"2024-10-16 0:16\"}"},
  {0.35552, "{\"Time\":0.35552, \"Channel\":2, \"ID\":6, \"Flags\":\"196610\", \"DLC\":10, \"Data\":[\"47\", \"f3\", \"4d\", \"3f\", \"5b\", \"9c\", \"45\", \"3f\", \"36\", \"85\", \"86\", \"3f\"], \"Counter\":5, \"AbsTime\":\"2024-10-16 0:16\"}"},
  {0.35634, "{\"Time\":0.35634, \"Channel\":2, \"ID\":101, \"Flags\":\"196610\", \"DLC\":10, \"Data\":[\"06\", \"69\", \"8d\", \"46\", \"31\", \"45\", \"1e\", \"46\", \"6e\", \"a8\", \"87\", \"45\"], \"Counter\":6, \"AbsTime\":\"2024-10-16 0:16\"}"},
  {0.35835, "{\"Time\":0.35835, \"Channel\":2, \"ID\":259, \"Flags\":\"196610\", \"DLC\":10, \"Data\":[\"de\", \"08\", \"c1\", \"08\", \"57\", \"0b\", \"a6\", \"09\", \"08\", \"0d\", \"a0\", \"0d\", \"b8\", \"01\", \"ff\", \"0f\"], \"Counter\":7, \"AbsTime\":\"2024-10-16 0:16\"}"},
  {0.36158, "{\"Time\":0.36158, \"Channel\":1, \"ID\":513, \"Flags\":2, \"DLC\":3, \"Data\":[\"90\", \"00\", \"00\"], \"Counter\":8, \"AbsTime\":\"2024-10-16 0:16\"}"},
  {0.36235, "{\"Time\":0.36235, \"Channel\":2, \"ID\":259, \"Flags\":\"196610\", \"DLC\":10, \"Data\":[\"df\", \"08\", \"c1\", \"08\", \"57\", \"0b\", \"a7\", \"09\", \"06\", \"0d\", \"a1\", \"0d\", \"b7\", \"01\", \"ff\", \"0f\"], \"Counter\":9, \"AbsTime\":\"2024-10-16 0:16\"}"},
  {0.36439, "{\"Time\":0.36439, \"Channel\":2, \"ID\":1552, \"Flags\":\"196610\", \"DLC\":11, \"Data\":[\"f3\", \"03\", \"00\", \"64\", \"42\", \"04\", \"41\", \"1c\", \"18\", \"45\", \"6f\", \"06\", \"02\", \"ad\", \"05\", \"c4\"], \"Counter\":10, \"AbsTime\":\"2024-10-16 0:16\"}"},
  {0.36452, "{\"Time\":0.36452, \"Channel\":2, \"ID\":1553, \"Flags\":\"196610\", \"DLC\":11, \"Data\":[\"47\", \"f7\", \"09\", \"28\", \"d8\", \"03\", \"6e\", \"d0\", \"08\", \"b9\", \"15\", \"08\", \"b1\", \"43\", \"07\", \"f2\"], \"Counter\":11, \"AbsTime\":\"2024-10-16 0:16\"}"},
  {0.36635, "{\"Time\":0.36635, \"Channel\":2, \"ID\":259, \"Flags\":\"196610\", \"DLC\":10, \"Data\":[\"de\", \"08\", \"c1\", \"08\", \"57\", \"0b\", \"a7\", \"09\", \"07\", \"0d\", \"9e\", \"0d\", \"b7\", \"01\", \"ff\", \"0f\"], \"Counter\":12, \"AbsTime\":\"2024-10-16 0:16\"}"},
  {0.36646, "{\"Time\":0.36646, \"Channel\":2, \"ID\":101, \"Flags\":\"196610\", \"DLC\":10, \"Data\":[\"06\", \"69\", \"8d\", \"46\", \"31\", \"45\", \"1e\", \"46\", \"6e\", \"a8\", \"87\", \"45\"], \"Counter\":13, \"AbsTime\":\"2024-10-16 0:16\"}"},
  {0.36751, "{\"Time\":0.36751, \"Channel\":2, \"ID\":6, \"Flags\":\"196610\", \"DLC\":10, \"Data\":[\"19\", \"50\", \"4e\", \"3f\", \"c4\", \"ca\", \"45\", \"3f\", \"36\", \"85\", \"86\", \"3f\"], \"Counter\":14, \"AbsTime\":\"2024-10-16 0:16\"}"},
  {0.37035, "{\"Time\":0.37035, \"Channel\":2, \"ID\":259, \"Flags\":\"196610\", \"DLC\":10, \"Data\":[\"de\", \"08\", \"c2\", \"08\", \"58\", \"0b\", \"a8\", \"09\", \"06\", \"0d\", \"a1\", \"0d\", \"b7\", \"01\", \"ff\", \"0f\"], \"Counter\":15, \"AbsTime\":\"2024-10-16 0:16\"}"},
  {0.37358, "{\"Time\":0.37358, \"Channel\":1, \"ID\":513, \"Flags\":2, \"DLC\":3, \"Data\":[\"90\", \"00\", \"00\"], \"Counter\":16, \"AbsTime\":\"2024-10-16 0:16\"}"},
  {0.37435, "{\"Time\":0.37435, \"Channel\":2, \"ID\":259, \"Flags\":\"196610\", \"DLC\":10, \"Data\":[\"e0\", \"08\", \"c1\", \"08\", \"57\", \"0b\", \"a7\", \"09\", \"07\", \"0d\", \"a1\", \"0d\", \"b7\", \"01\", \"ff\", \"0f\"], \"Counter\":17, \"AbsTime\":\"2024-10-16 0:16\"}"},
  {0.37539, "{\"Time\":0.37539, \"Channel\":2, \"ID\":1552, \"Flags\":\"196610\", \"DLC\":11, \"Data\":[\"5d\", \"05\", \"00\", \"3b\", \"47\", \"04\", \"97\", \"45\", \"18\", \"bb\", \"6e\", \"06\", \"ed\", \"a2\", \"05\", \"3c\"], \"Counter\":18, \"AbsTime\":\"2024-10-16 0:16\"}"},
  {0.37552, "{\"Time\":0.37552, \"Channel\":2, \"ID\":1553, \"Flags\":\"196610\", \"DLC\":11, \"Data\":[\"51\", \"f7\", \"09\", \"ed\", \"d3\", \"03\", \"5c\", \"cf\", \"08\", \"97\", \"17\", \"8\", \"7a\", \"43\", \"07\", \"7a\", \"5d\", \"8\", \"0\", \"0\"], \"Counter\":19, \"AbsTime\":\"2024-10-16 0:16\"}"},
  {0.37634, "{\"Time\":0.37634, \"Channel\":2, \"ID\":101, \"Flags\":\"196610\", \"DLC\":10, \"Data\":[\"06\", \"69\", \"8d\", \"46\", \"31\", \"45\", \"1e\", \"46\", \"6e\", \"a8\", \"87\", \"45\", \"0\", \"0\", \"0\", \"0\"], \"Counter\":20, \"AbsTime\":\"2024-10-16 0:16\"}"},
  {0.37834, "{\"Time\":0.37834, \"Channel\":2, \"ID\":259, \"Flags\":\"196610\", \"DLC\":10, \"Data\":[\"e0\", \"08\", \"c1\", \"08\", \"57\", \"0b\", \"a6\", \"09\", \"08\", \"0d\", \"a1\", \"0d\", \"b7\", \"01\", \"ff\", \"0f\"], \"Counter\":21, \"AbsTime\":\"2024-10-16 0:16\"}"},
  {0.37951, "{\"Time\":0.37951, \"Channel\":2, \"ID\":6, \"Flags\":\"196610\", \"DLC\":10, \"Data\":[\"b0\", \"21\", \"4e\", \"3f\", \"5b\", \"9c\", \"45\", \"3f\", \"9f\", \"b3\", \"86\", \"3f\", \"0\", \"0\", \"0\", \"0\"], \"Counter\":22, \"AbsTime\":\"2024-10-16 0:16\"}"},
  {0.38235, "{\"Time\":0.38235, \"Channel\":2, \"ID\":259, \"Flags\":\"196610\", \"DLC\":10, \"Data\":[\"df\", \"08\", \"c3\", \"08\", \"58\", \"0b\", \"a6\", \"09\", \"07\", \"0d\", \"a0\", \"0d\", \"b7\", \"01\", \"ff\", \"0f\"], \"Counter\":23, \"AbsTime\":\"2024-10-16 0:16\"}"},
  {0.38556, "{\"Time\":0.38556, \"Channel\":1, \"ID\":513, \"Flags\":2, \"DLC\":3, \"Data\":[\"90\", \"00\", \"00\"], \"Counter\":24, \"AbsTime\":\"2024-10-16 0:16\"}"},
  {0.38635, "{\"Time\":0.38635, \"Channel\":2, \"ID\":259, \"Flags\":\"196610\", \"DLC\":10, \"Data\":[\"df\", \"08\", \"c2\", \"08\", \"57\", \"0b\", \"a8\", \"09\", \"08\", \"0d\", \"a0\", \"0d\", \"b7\", \"01\", \"ff\", \"0f\"], \"Counter\":25, \"AbsTime\":\"2024-10-16 0:16\"}"},
  {0.38646, "{\"Time\":0.38646, \"Channel\":2, \"ID\":101, \"Flags\":\"196610\", \"DLC\":10, \"Data\":[\"06\", \"69\", \"8d\", \"46\", \"31\", \"45\", \"1e\", \"46\", \"6e\", \"a8\", \"87\", \"45\", \"0\", \"0\", \"0\", \"0\"], \"Counter\":26, \"AbsTime\":\"2024-10-16 0:16\"}"},
  {0.38660, "{\"Time\":0.3866, \"Channel\":2, \"ID\":1552, \"Flags\":\"196610\", \"DLC\":11, \"Data\":[\"60\", \"05\", \"00\", \"e0\", \"42\", \"04\", \"d4\", \"6e\", \"18\", \"90\", \"72\", \"06\", \"38\", \"a5\", \"05\", \"04\", \"b1\", \"0c\", \"0\", \"0\"], \"Counter\":27, \"AbsTime\":\"2024-10-16 0:16\"}"},
  {0.39035, "{\"Time\":0.39035, \"Channel\":2, \"ID\":259, \"Flags\":\"196610\", \"DLC\":10, \"Data\":[\"e0\", \"08\", \"c2\", \"08\", \"57\", \"0b\", \"a6\", \"09\", \"07\", \"0d\", \"a0\", \"0d\", \"b8\", \"01\", \"ff\", \"0f\"], \"Counter\":28, \"AbsTime\":\"2024-10-16 0:16\"}"},
  {0.39149, "{\"Time\":0.39149, \"Channel\":2, \"ID\":6, \"Flags\":\"196610\", \"DLC\":10, \"Data\":[\"19\", \"50\", \"4e\", \"3f\", \"5b\", \"9c\", \"45\", \"3f\", \"36\", \"85\", \"86\", \"3f\", \"0\", \"0\", \"0\", \"0\"], \"Counter\":29, \"AbsTime\":\"2024-10-16 0:16\"}"},
  {0.39435, "{\"Time\":0.39435, \"Channel\":2, \"ID\":259, \"Flags\":\"196610\", \"DLC\":10, \"Data\":[\"e0\", \"08\", \"c2\", \"08\", \"56\", \"0b\", \"a6\", \"09\", \"07\", \"0d\", \"a0\", \"0d\", \"b7\", \"01\", \"ff\", \"0f\"], \"Counter\":30, \"AbsTime\":\"2024-10-16 0:16\"}"},
  {0.39634, "{\"Time\":0.39634, \"Channel\":2, \"ID\":101, \"Flags\":\"196610\", \"DLC\":10, \"Data\":[\"06\", \"69\", \"8d\", \"46\", \"31\", \"45\", \"1e\", \"46\", \"6e\", \"a8\", \"87\", \"45\", \"0\", \"0\", \"0\", \"0\"], \"Counter\":31, \"AbsTime\":\"2024-10-16 0:16\"}"},
  {0.39739, "{\"Time\":0.39739, \"Channel\":2, \"ID\":1552, \"Flags\":\"196610\", \"DLC\":11, \"Data\":[\"37\", \"07\", \"00\", \"aa\", \"48\", \"04\", \"bc\", \"8d\", \"18\", \"55\", \"71\", \"06\", \"7d\", \"ab\", \"05\", \"04\", \"b1\", \"0c\", \"0\", \"0\"], \"Counter\":32, \"AbsTime\":\"2024-10-16 0:16\"}"},
  {0.39752, "{\"Time\":0.39752, \"Channel\":2, \"ID\":1553, \"Flags\":\"196610\", \"DLC\":11, \"Data\":[\"54\", \"f9\", \"09\", \"95\", \"d6\", \"03\", \"8e\", \"d1\", \"08\", \"08\", \"24\", \"08\", \"c6\", \"42\", \"07\", \"7a\", \"5d\", \"08\", \"0\", \"0\"], \"Counter\":33, \"AbsTime\":\"2024-10-16 0:16\"}"},
  {0.39755, "{\"Time\":0.39755, \"Channel\":1, \"ID\":513, \"Flags\":2, \"DLC\":3, \"Data\":[\"90\", \"00\", \"00\"], \"Counter\":34, \"AbsTime\":\"2024-10-16 0:16\"}"},
  {0.39834, "{\"Time\":0.39834, \"Channel\":2, \"ID\":259, \"Flags\":\"196610\", \"DLC\":10, \"Data\":[\"e0\", \"08\", \"c2\", \"08\", \"57\", \"0b\", \"a7\", \"09\", \"08\", \"0d\", \"a0\", \"0d\", \"b9\", \"01\", \"ff\", \"0f\"], \"Counter\":35, \"AbsTime\":\"2024-10-16 0:16\"}"},
  {0.40234, "{\"Time\":0.40234, \"Channel\":2, \"ID\":259, \"Flags\":\"196610\", \"DLC\":10, \"Data\":[\"e1\", \"08\", \"c5\", \"08\", \"57\", \"0b\", \"a8\", \"09\", \"09\", \"0d\", \"a1\", \"0d\", \"b7\", \"01\", \"ff\", \"0f\"], \"Counter\":36, \"AbsTime\":\"2024-10-16 0:16\"}"},
  {0.40348, "{\"Time\":0.40348, \"Channel\":2, \"ID\":6, \"Flags\":\"196610\", \"DLC\":10, \"Data\":[\"b0\", \"21\", \"4e\", \"3f\", \"c4\", \"ca\", \"45\", \"3f\", \"9f\", \"b3\", \"86\", \"3f\", \"00\", \"00\", \"00\", \"00\"], \"Counter\":37, \"AbsTime\":\"2024-10-16 0:16\"}"},
  {0.40635, "{\"Time\":0.40635, \"Channel\":2, \"ID\":259, \"Flags\":\"196610\", \"DLC\":10, \"Data\":[\"e0\", \"08\", \"c3\", \"08\", \"58\", \"0b\", \"a6\", \"09\", \"06\", \"0d\", \"a1\", \"0d\", \"b9\", \"01\", \"ff\", \"0f\"], \"Counter\":38, \"AbsTime\":\"2024-10-16 0:16\"}"},
  {0.40646, "{\"Time\":0.40646, \"Channel\":2, \"ID\":101, \"Flags\":\"196610\", \"DLC\":10, \"Data\":[\"06\", \"69\", \"8d\", \"46\", \"31\", \"45\", \"1e\", \"46\", \"6e\", \"a8\", \"87\", \"45\", \"00\", \"00\", \"00\", \"00\"], \"Counter\":39, \"AbsTime\":\"2024-10-16 0:16\"}"},
  {0.40839, "{\"Time\":0.40839, \"Channel\":2, \"ID\":1552, \"Flags\":\"196610\", \"DLC\":11, \"Data\":[\"5d\", \"05\", \"00\", \"63\", \"47\", \"04\", \"3c\", \"b7\", \"18\", \"69\", \"70\", \"06\", \"4f\", \"a5\", \"05\", \"3b\", \"b4\", \"0c\", \"00\", \"00\"], \"Counter\":40, \"AbsTime\":\"2024-10-16 0:16\"}"},
  {0.40852, "{\"Time\":0.40852, \"Channel\":2, \"ID\":1553, \"Flags\":\"196610\", \"DLC\":11, \"Data\":[\"6f\", \"fd\", \"09\", \"87\", \"d3\", \"03\", \"bb\", \"d1\", \"08\", \"cf\", \"1f\", \"08\", \"75\", \"43\", \"07\", \"86\", \"63\", \"08\", \"00\", \"00\"], \"Counter\":41, \"AbsTime\":\"2024-10-16 0:16\"}"},
  {0.40955, "{\"Time\":0.40955, \"Channel\":1, \"ID\":513, \"Flags\":2, \"DLC\":3, \"Data\":[\"90\", \"00\", \"00\"], \"Counter\":42, \"AbsTime\":\"2024-10-16 0:16\"}"},
  {0.41035, "{\"Time\":0.41035, \"Channel\":2, \"ID\":259, \"Flags\":\"196610\", \"DLC\":10, \"Data\":[\"e2\", \"08\", \"c4\", \"08\", \"59\", \"0b\", \"a6\", \"09\", \"09\", \"0d\", \"a1\", \"0d\", \"b8\", \"01\", \"ff\", \"0f\"], \"Counter\":43, \"AbsTime\":\"2024-10-16 0:16\"}"},
  {0.41435, "{\"Time\":0.41435, \"Channel\":2, \"ID\":259, \"Flags\":\"196610\", \"DLC\":10, \"Data\":[\"e1\", \"08\", \"c4\", \"08\", \"57\", \"0b\", \"a7\", \"09\", \"07\", \"0d\", \"a0\", \"0d\", \"b8\", \"01\", \"ff\", \"0f\"], \"Counter\":44, \"AbsTime\":\"2024-10-16 0:16\"}"},
  {0.41548, "{\"Time\":0.41548, \"Channel\":2, \"ID\":6, \"Flags\":\"196610\", \"DLC\":10, \"Data\":[\"b0\", \"21\", \"4e\", \"3f\", \"5b\", \"9c\", \"45\", \"3f\", \"36\", \"85\", \"86\", \"3f\", \"00\", \"00\", \"00\", \"00\"], \"Counter\":45, \"AbsTime\":\"2024-10-16 0:16\"}"},
  {0.41634, "{\"Time\":0.41634, \"Channel\":2, \"ID\":101, \"Flags\":\"196610\", \"DLC\":10, \"Data\":[\"06\", \"69\", \"8d\", \"46\", \"31\", \"45\", \"1e\", \"46\", \"6e\", \"a8\", \"87\", \"45\", \"00\", \"00\", \"00\", \"00\"], \"Counter\":46, \"AbsTime\":\"2024-10-16 0:16\"}"},
  {0.41835, "{\"Time\":0.41835, \"Channel\":2, \"ID\":259, \"Flags\":\"196610\", \"DLC\":10, \"Data\":[\"e1\", \"08\", \"c4\", \"08\", \"57\", \"0b\", \"a7\", \"09\", \"07\", \"0d\", \"a1\", \"0d\", \"b8\", \"01\", \"ff\", \"0f\"], \"Counter\":47, \"AbsTime\":\"2024-10-16 0:16\"}"},
  {0.41939, "{\"Time\":0.41939, \"Channel\":2, \"ID\":1552, \"Flags\":\"196610\", \"DLC\":11, \"Data\":[\"42\", \"02\", \"00\", \"05\", \"47\", \"04\", \"90\", \"dc\", \"18\", \"0d\", \"70\", \"06\", \"21\", \"a7\", \"05\", \"22\", \"b3\", \"0c\", \"00\", \"00\"], \"Counter\":48, \"AbsTime\":\"2024-10-16 0:16\"}"},
  {0.41952, "{\"Time\":0.41952, \"Channel\":2, \"ID\":1553, \"Flags\":\"196610\", \"DLC\":11, \"Data\":[\"95\", \"fe\", \"09\", \"e9\", \"d4\", \"03\", \"e6\", \"d1\", \"08\", \"6c\", \"2a\", \"08\", \"fc\", \"44\", \"07\", \"ce\", \"64\", \"08\", \"00\", \"00\"], \"Counter\":49, \"AbsTime\":\"2024-10-16 0:16\"}"},
  {0.42154, "{\"Time\":0.42154, \"Channel\":1, \"ID\":513, \"Flags\":2, \"DLC\":3, \"Data\":[\"90\", \"00\", \"00\"], \"Counter\":50, \"AbsTime\":\"2024-10-16 0:16\"}"}
  // Add more packets as needed
};

int packetIndex = 0;
unsigned long lastPacketTime = 0;

void setup() {
  Serial.begin(9600);
  connectWiFi();
  connectServer();
}

void connectWiFi() {
  Serial.print("Connecting to WiFi: ");
  Serial.println(ssid);
  WiFi.begin(ssid, password);

  while (WiFi.status() != WL_CONNECTED) {
    delay(500);
    Serial.print(".");
  }

  Serial.println("\nWiFi connected.");
  Serial.print("ESP32 IP: ");
  Serial.println(WiFi.localIP());
}

void connectServer() {
  Serial.print("Connecting to server ");
  Serial.print(serverIP);
  Serial.print(":");
  Serial.println(serverPort);

  if (!client.connect(serverIP, serverPort)) {
    Serial.println("Connection to server failed.");
  } else {
    Serial.println("Connected to server.");
  }
}

void loop() {
  if (!client.connected()) {
    Serial.println("Disconnected, reconnecting...");
    connectServer();
  }

  if (packetIndex < (sizeof(canData) / sizeof(canData[0]))) {
    float timeDiff = 0;
    if (packetIndex > 0) {
      timeDiff = (canData[packetIndex].timestamp - canData[packetIndex - 1].timestamp) * 1000;
    }

    unsigned long currentMillis = millis();
    if (currentMillis - lastPacketTime >= timeDiff) {
      sendPacket();
      lastPacketTime = currentMillis;
    }
  } else {
    Serial.println("End of CAN data snapshot. Restarting...");
    packetIndex = 0;
  }
}

void sendPacket() {
  String packet = canData[packetIndex].data;
  Serial.print("Sending: ");
  Serial.println(packet);

  client.println(packet);
  packetIndex++;
}



